#include <alsa/asoundlib.h>

#define PERIOD_SIZE 256
static snd_pcm_t *audio_handle_tx = NULL;
static snd_pcm_t *audio_handle_rx = NULL;

enum {CID_ST_WAIT_HS, CID_ST_HS_1400, CID_ST_HS_MUTE_1, CID_ST_HS_2300, CID_ST_HS_MUTE_2,
      CID_ST_TRANSMIT, CID_ST_WAIT_ACK, CID_ST_ACK};
static volatile int contactid_sm;
static volatile int contactid_sm_count;
static volatile int contactid_idx;
static int contactid_retry;

/* Coefficienti validi per campionamento 8000Hz e buffer di 80 campioni */
#define COEFF_1400 0.907981038094
#define COEFF_2300 -0.466890782118
#define THR 100000000.0
#define NCTONE 410

static const short dtmf_0[] = {
10920,15032,10536,1664,-4960,-5696,-2296,176,-1696,-6504,
-9096,-5232,4256,13488,15816,9096,-2472,-11448,-12704,-7024,
72,3208,1432,-1432,-688,4624,10512,11176,4144,-7088,
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-8008,-6944,600,10512,15856,12288,1632,-9272,-13728,-10032,
};

static const short dtmf_1[] = {
11360,14352,8112,-448,-3824,-1064,1936,-712,-8152,-13104,
-9112,2512,13264,15008,7416,-2160,-5968,-3096,464,-1264,
-7544,-11360,-6688,4840,14664,15008,6088,-4280,-8192,-4848,
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-4832,7352,13048,9400,1840,-1880,456,3792,1624,-6520,
};

static const short dtmf_2[] = {
11768,13272,5448,-1496,-576,3960,2680,-6560,-14960,-12664,
-536,10304,10872,3880,-456,2720,7232,3928,-7184,-15840,
-12896,-992,8384,7872,1928,360,5776,10200,5136,-7336,
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-1384,9280,9928,3440,-112,3720,8432,4864,-6712,-15784,
};

static const short dtmf_3[] = {
12112,11744,2848,-808,4280,6920,-1672,-13816,-14992,-3824,
6064,4864,-672,1656,10776,13208,2496,-10680,-12448,-4120,
784,-3616,-7504,-416,12312,15816,5968,-4960,-5320,376,
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-9648,4168,13440,9472,792,72,5936,5632,-5448,-15696,
};

static const short dtmf_4[] = {
11312,15416,10312,416,-7224,-8360,-4352,-200,200,-2488,
-4024,-768,6384,12144,10976,1992,-9632,-16184,-13128,-2560,
8352,12816,9216,1744,-3512,-3648,-792,424,-2408,-7040,
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-9512,-15848,-12616,-2664,6912,10248,6864,1232,-1512,-56,
};

static const short dtmf_5[] = {
11760,14736,7896,-1704,-6088,-3728,-112,-1096,-6256,-9088,
-4040,6976,15392,13672,2576,-9264,-13128,-7832,40,3192,
728,-1760,1088,8024,11848,6728,-5224,-15024,-14744,-4800,
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-6344,-1552,-168,-3776,-7104,-3920,5680,14304,13840,3440,
};

static const short dtmf_6[] = {
12168,13656,5224,-2752,-2840,1296,632,-6944,-13056,-8648,
4528,14768,13000,2536,-5288,-4368,72,-800,-7608,-11376,
-4624,8608,16168,11056,-888,-7912,-5536,-536,-1416,-7288,
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-2888,376,-3296,-9736,-9064,1680,13656,15376,5504,-5816,
};

static const short dtmf_7[] = {
12504,12128,2632,-2064,2016,4248,-3728,-14200,-13096,184,
11144,9328,1456,312,5936,6112,-4656,-15424,-12872,336,
9064,5984,272,2760,9488,7536,-5344,-15704,-11880,424,
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-11152,-4728,216,-3704,-8152,-1968,11160,16136,6760,-5720,
};

static const short dtmf_8[] = {
11736,15720,9784,-1320,-9848,-10808,-5272,1352,4192,2672,
232,512,3624,5904,3432,-3808,-11048,-12128,-4712,7120,
15424,14136,3792,-8688,-15048,-11656,-1808,7208,9832,5976,
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-12744,-15744,-8640,4080,13928,14584,6352,-4448,-10552,-9024,
};

static const short dtmf_9[] = {
12184,15048,7368,-3448,-8712,-6176,-1032,456,-2264,-3920,
216,8264,12640,7432,-4960,-15072,-14544,-3768,8456,12888,
7800,-440,-4328,-2408,312,-1272,-6232,-8240,-2504,8216,
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-9568,-1440,3800,2968,-80,408,5168,8608,4792,-5512,
};

static const short dtmf_10[] = {
12592,13968,4696,-4496,-5464,-1144,-280,-5384,-9072,-3480,
8792,16064,10240,-3688,-12840,-10184,-1336,3256,800,-1688,
2440,9928,10744,616,-12424,-15920,-6544,6240,10824,5728,
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-6112,480,680,-2984,-2040,6016,13144,9680,-3536,-14776,
};

static const short dtmf_11[] = {
12928,12432,2104,-3808,-600,1808,-4648,-12640,-9104,5352,
15400,10616,-1296,-5920,-1600,296,-6072,-11360,-4456,10024,
16136,7304,-5144,-7672,-2040,-464,-6352,-8920,360,13448,
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-14384,-4624,4192,3040,-1128,2368,10656,10448,-2280,-14688,
};

static const short dtmf_12[] = {
12176,15904,8904,-3488,-12488,-12400,-4416,4952,9256,6744,
896,-3224,-3296,-1080,-8,-1488,-3464,-2544,2224,7704,
8792,3008,-6632,-13208,-11048,-584,11280,16024,9848,-3192,
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2256,-192,16,1696,1624,-1768,-6256,-7352,-2440,6120,
};

static const short dtmf_13[] = {
12616,15232,6480,-5616,-11352,-7768,-176,4056,2792,144,
880,4528,5712,440,-8408,-12760,-6960,5808,15400,13464,
1168,-11560,-14760,-6928,4312,9792,6856,560,-2488,-952,
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5432,14096,12464,576,-12392,-15944,-7432,5712,12904,9632,
};

static const short dtmf_14[] = {
13024,14152,3816,-6656,-8112,-2744,560,-1784,-4008,584,
9456,12320,3312,-10680,-16288,-7864,6240,12840,7744,-1112,
-4184,-1192,312,-3896,-8424,-4848,6536,15048,10840,-3440,
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8880,16024,9344,-5376,-14352,-10328,536,6784,4568,368,
};

static const short dtmf_15[] = {
13368,12616,1224,-5976,-3248,208,-3792,-9040,-4040,9424,
16064,6880,-8224,-12912,-5048,2616,1504,-1776,2480,10608,
9504,-3808,-15576,-12200,1952,10592,6728,-112,376,4272,
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616,10920,12856,656,-13440,-13984,-1952,7552,5824,456,
};

static const short *contactid_athena_dtmf_tone[16] = {
  dtmf_13,	// 0
  dtmf_0,	// 1
  dtmf_1,	// 2
  dtmf_2,	// 3
  dtmf_4,	// 4
  dtmf_5,	// 5
  dtmf_6,	// 6
  dtmf_8,	// 7
  dtmf_9,	// 8
  dtmf_10,	// 9
  dtmf_13,	// A	- il valore 10 corrisponde al tasto 0
  dtmf_12,	// B (*)
  dtmf_14,	// C (#)
  dtmf_3,	// D (A)
  dtmf_7,	// E (B)
  dtmf_11,	// F (C)
};

void CID_init()
{
  if(!CID_delay) CID_delay = timeout_init();
}

int CID_decode(int freq, short *sample)
{
  float Q0;
  float Q1_1, Q2_1, Q1_2, Q2_2;
  int i;
  
  /* Facendo dei test ho visto che con 160 campioni il filtro diventa troppo
     selettivo, e in particolare quello per i 2300Hz presenta due zeri all'interno
     della banda da considerare (+/-3%) a 2250 e 2350. La banda deve invece essere
     tra 2230 e 2370Hz minimo. Con 80 campioni invece la banda si allarga a coprire
     bene tutto l'intervallo.
     Sul filtro a 1400Hz lo zero cade sempre bene in centro sia con 80 che 160 campioni.
     
     Per la decodifica dei 1400Hz invece andrebbero bene sia 80 che 160 campioni.
     Con 160 cadono in tutto 3 zeri nella banda dei 2300Hz, a 2250, 2300 e 2350Hz.
     Con 80 campioni lo zero si ha solo a 2300Hz, ma le magnitudini nell'intorno
     rimangono ampiamente inferiori a quelle rilevate per 1400Hz.
     
     Quindo occorre gestire la decodifica dell'algoritmo di Goertzel con buffer
     di 80 campioni. */
     
  /* Calcolare sempre sia 1400 che 2300 per fare confronti relativi. */
  
  Q1_1 = Q2_1 = Q1_2 = Q2_2 = 0.0;
  for(i=0; i<80; i++)
  {
    Q0 = COEFF_1400 * Q1_1 - Q2_1 + (float)sample[i];
    Q2_1 = Q1_1;
    Q1_1 = Q0;
    Q0 = COEFF_2300 * Q1_2 - Q2_2 + (float)sample[i];
    Q2_2 = Q1_2;
    Q1_2 = Q0;
  }
  Q1_1 = Q1_1 * Q1_1 + Q2_1 * Q2_1 - Q1_1 * Q2_1 * COEFF_1400;
  Q1_2 = Q1_2 * Q1_2 + Q2_2 * Q2_2 - Q1_2 * Q2_2 * COEFF_2300;
  if((Q1_1 > THR) || (Q1_2 > THR))
  {
    if(((freq == 1400) && (Q1_1 > (Q1_2*3))) ||
       ((freq == 2300) && (Q1_2 > (Q1_1*3))))
      return 1;
  }
  return 0;
}

/* Preparo il buffer dati con i toni da trasmettere.
   Sono 16 toni spaziati da 15 silenzi, più il silenzio
   finale per arrivare a blocchi interi di PERIOD_SIZE. */
static unsigned short audio_tx_data[(((16+16)*NCTONE+PERIOD_SIZE-1)/PERIOD_SIZE)*PERIOD_SIZE];
static int audio_tx_idx;
/* Per la ricezione uso un buffer da 5K campioni, che è
   multiplo sia di 80 che di 1024. In questo modo posso
   gestirlo come buffer circolare senza avere sfridi. */
static unsigned short audio_rx_data[5*1024];
static int audio_rx_idx;
static int audio_rx_len;
static int audio_rx_out;
static pthread_mutex_t audio_rx_mutex = PTHREAD_MUTEX_INITIALIZER;

static int audio_tx_queue()
{
  int err;
  
  /* Se è stato accodato tutto l'audio del messaggio */
  if(audio_tx_idx >= (sizeof(audio_tx_data)/sizeof(short))) return 0;
  
  err = snd_pcm_writei(audio_handle_tx, audio_tx_data+audio_tx_idx, PERIOD_SIZE);
  if(err >= 0) audio_tx_idx += err;
  return err;
}

static void audio_tx_callback(snd_async_handler_t *ahandler)
{
  snd_pcm_t *handle = snd_async_handler_get_pcm(ahandler);
  snd_pcm_sframes_t avail;
  int err;
  
  avail = snd_pcm_avail_update(handle);
  while (avail >= PERIOD_SIZE)
  {
    err = audio_tx_queue();
    if(err <= 0) return;
    avail = snd_pcm_avail_update(handle);
  }
}

static void audio_tx_play(unsigned char *ev)
{
  int i, err;
  
  audio_tx_idx = 0;
  
  memset(audio_tx_data, 0, sizeof(audio_tx_data));
  for(i=0; i<16; i++)
    memcpy(audio_tx_data+(i*2*NCTONE), contactid_athena_dtmf_tone[ev[i]], sizeof(dtmf_0));
  
  if(snd_pcm_state(audio_handle_tx) == SND_PCM_STATE_XRUN)
    err = snd_pcm_recover(audio_handle_tx, -EPIPE, 1);
  
  for(i=0; i<8; i++) audio_tx_queue();
  //err = snd_pcm_start(audio_handle_tx);
}

static void audio_rx_callback(snd_async_handler_t *ahandler)
{
  /* Su iMX51 il callback funziona solo se si chiedono 2048 frames.
     Non ne arrivano di più, e di meno manda in overrun. */
  /* Anche 1024 va bene, la callback viene chiamata più frequente.
     Con 512 invece si va in overrun. */
  snd_pcm_t *handle = snd_async_handler_get_pcm(ahandler);
  int err;
  
  err = snd_pcm_readi (handle, audio_rx_data+audio_rx_idx, 1024);
  if(err < 0)
  {
    /* Overrun - faccio ripartire */
    err = snd_pcm_recover(handle, -EPIPE, 1);
    snd_pcm_start(handle);
  }
  else
  {
    audio_rx_idx += err;
    if(audio_rx_idx >= (sizeof(audio_rx_data)/sizeof(short)))
      audio_rx_idx = 0;
    pthread_mutex_lock(&audio_rx_mutex);
    audio_rx_len += err;
    pthread_mutex_unlock(&audio_rx_mutex);
  }
}

static int CID_tentativi = 0;

void contactid_close_on_error(int *msg)
{
  snd_pcm_close(audio_handle_tx);
  audio_handle_tx = NULL;
  snd_pcm_close(audio_handle_rx);
  audio_handle_rx = NULL;
  
  CID_tentativi++;
  if(CID_tentativi > 8)
  {
    CID_tentativi = 0;
    CID_set_error(2);
    *msg = 0;
  }
  else
    timeout_on(CID_delay, NULL, NULL, 0, CID_DELAY);
}

void CID_transmit(int fd, int *msg, unsigned char *ev)
{
  int i, err, rx_timeout;
  snd_pcm_hw_params_t *hw_params;
  snd_async_handler_t *ahandler;
  short *psamp;
  
  /* Verifico che l'audio sia abilitato al contactid */
  if(!audio_version || ((audio_version&0xff0000)<0x20000))
  {
    *msg = 0;
    CID_set_error(3);
    return;
  }
  
  /* Attivo gli stream audio */
  if((err = snd_pcm_open(&audio_handle_tx, "default", SND_PCM_STREAM_PLAYBACK, 0)) < 0)
  {
    support_log("Dispositivo audio non trovato.");
    return;
  }
  
  i = 8000;
  hw_params = NULL;
  if((snd_pcm_hw_params_malloc(&hw_params) < 0) ||
     (snd_pcm_hw_params_any(audio_handle_tx, hw_params) < 0) ||
     (snd_pcm_hw_params_set_access(audio_handle_tx, hw_params, SND_PCM_ACCESS_RW_INTERLEAVED) < 0) ||
     (snd_pcm_hw_params_set_format(audio_handle_tx, hw_params, SND_PCM_FORMAT_S16_LE) < 0) ||
     (snd_pcm_hw_params_set_rate_near(audio_handle_tx, hw_params, &i, 0) < 0) ||
     (snd_pcm_hw_params_set_channels(audio_handle_tx, hw_params, 1) < 0) ||
     (snd_pcm_hw_params(audio_handle_tx, hw_params) < 0))
  {
    snd_pcm_hw_params_free(hw_params);
    snd_pcm_close(audio_handle_tx);
    audio_handle_tx = NULL;
    return;
  }
  
  snd_pcm_hw_params_free(hw_params);
  err = snd_async_add_pcm_handler(&ahandler, audio_handle_tx, audio_tx_callback, NULL);
  
  if((err = snd_pcm_open(&audio_handle_rx, "default", SND_PCM_STREAM_CAPTURE, 0)) < 0)
  {
    snd_pcm_close(audio_handle_tx);
    audio_handle_tx = NULL;
    support_log("Dispositivo audio non trovato.");
    return;
  }
  
  i = 8000;
  hw_params = NULL;
  if((snd_pcm_hw_params_malloc(&hw_params) < 0) ||
     (snd_pcm_hw_params_any(audio_handle_rx, hw_params) < 0) ||
     (snd_pcm_hw_params_set_access(audio_handle_rx, hw_params, SND_PCM_ACCESS_RW_INTERLEAVED) < 0) ||
     (snd_pcm_hw_params_set_format(audio_handle_rx, hw_params, SND_PCM_FORMAT_S16_LE) < 0) ||
     (snd_pcm_hw_params_set_rate_near(audio_handle_rx, hw_params, &i, 0) < 0) ||
     (snd_pcm_hw_params_set_channels(audio_handle_rx, hw_params, 1) < 0) ||
     (snd_pcm_hw_params(audio_handle_rx, hw_params) < 0))
  {
    snd_pcm_hw_params_free(hw_params);
    snd_pcm_close(audio_handle_tx);
    audio_handle_tx = NULL;
    snd_pcm_close(audio_handle_rx);
    audio_handle_rx = NULL;
    return;
  }
  
  snd_pcm_hw_params_free(hw_params);
  
  err = snd_async_add_pcm_handler(&ahandler, audio_handle_rx, audio_rx_callback, NULL);
  
  contactid_sm = 0;
  contactid_sm_count = 0;
  contactid_idx = 0;
  
  audio_rx_idx = 0;
  audio_rx_len = 0;
  audio_rx_out = 0;
  snd_pcm_start(audio_handle_rx);
  
  while(1)
  {
    rx_timeout = 0;
    pthread_mutex_lock(&audio_rx_mutex);
    /* Se il gsm chiude non arrivano più dati audio,
       occorre quindi gestire un timeout che faccia
       uscire dal while. Deve arrivare un blocco audio
       ogni 125ms, ma mi cautelo un minimo di più. */
    while(audio_rx_len < 80)
    {
      pthread_mutex_unlock(&audio_rx_mutex);
      if(++rx_timeout > 20)	// basterebbe 13
      {
        contactid_close_on_error(msg);
        return;
      }
      usleep(10000);
      pthread_mutex_lock(&audio_rx_mutex);
    }
    audio_rx_len -= 80;
    pthread_mutex_unlock(&audio_rx_mutex);
    psamp = audio_rx_data + audio_rx_out;
    audio_rx_out += 80;
    if(audio_rx_out >= (sizeof(audio_rx_data)/sizeof(short)))
      audio_rx_out = 0;
    
    /* ContactID capture (10ms=80sample) */
    switch(contactid_sm)
    {
      case CID_ST_WAIT_HS:
        contactid_sm_count++;
#if 0
        /* Debug telefonico, invio a tempo e non su identificazione toni */
        if(contactid_sm_count > 200)
        {
          /* Dopo 2s di attesa procedo con l'invio */
            contactid_sm_count = 0;
            contactid_retry = 0;
printf("cid hs mute 2\n");
            contactid_sm = CID_ST_HS_MUTE_2;
        }
        else
#endif
        if(contactid_sm_count > 1000)
        {
          /* Il centro è muto da 10s */
          contactid_close_on_error(msg);
          return;
        }
        else if(CID_decode(1400, psamp))
        {
          contactid_sm_count = 0;
          contactid_sm = CID_ST_HS_1400;
        }
        break;
      case CID_ST_HS_1400:
        contactid_sm_count++;
        if(!CID_decode(1400, psamp))
        {
          if(contactid_sm_count < 13)
          {
            /* Tono breve, quindi ok */
            contactid_sm_count = 0;
            contactid_sm = CID_ST_HS_MUTE_1;
          }
          else
          {
            /* Tono lungo, altro formato. */
            contactid_sm_count = 0;
            contactid_sm = CID_ST_WAIT_HS;
          }
        }
        break;
      case CID_ST_HS_MUTE_1:
        contactid_sm_count++;
        if(CID_decode(2300, psamp))
        {
          contactid_sm_count = 0;
          contactid_sm = CID_ST_HS_2300;
        }
        else if(contactid_sm_count > 13)
        {
          /* Il secondo tono non è arrivato in tempo */
          contactid_sm_count = 0;
          contactid_sm = CID_ST_WAIT_HS;
        }
        break;
      case CID_ST_HS_2300:
        contactid_sm_count++;
        if(!CID_decode(2300, psamp))
        {
          if(contactid_sm_count < 13)
          {
            /* Tono breve, quindi handshake ok */
            contactid_sm_count = 0;
            contactid_retry = 0;
            contactid_sm = CID_ST_HS_MUTE_2;
          }
          else
          {
            /* Tono lungo, altro formato. */
            contactid_sm_count = 0;
            contactid_sm = CID_ST_WAIT_HS;
          }
        }
        break;
      case CID_ST_HS_MUTE_2:
        contactid_sm_count++;
        /* Qui devo semplicemente attendere 250ms prima
           di partire con la trasmissione dell'evento. */
        /* Ne aspetto 270 per sicurezza, è capitato di dover
           ripetere qualche invio che poi ha ricevuto l'ack.
           Le specifiche dicono "250 (max 300)". */
        if(contactid_sm_count > 26)
        {
          contactid_sm_count = 0;
          contactid_sm = CID_ST_TRANSMIT;
          audio_tx_play(ev);
        }
        break;
      case CID_ST_TRANSMIT:
        contactid_sm_count++;
        if(contactid_sm_count > 250)
        {
          /* Timeout riproduzione, il gsm ha chiuso */
          contactid_close_on_error(msg);
          return;
        }
        else if(snd_pcm_state(audio_handle_tx) != SND_PCM_STATE_RUNNING)
        {
          contactid_sm_count = 0;
          contactid_sm = CID_ST_WAIT_ACK;
        }
        break;
      case CID_ST_WAIT_ACK:
        contactid_sm_count++;
        if(contactid_sm_count >= 125)	// 1250ms
        {
          contactid_retry++;
          if(contactid_retry < 8)
          {
            /* Ritrasmetto l'evento in coda già pronto */
            contactid_sm_count = 0;
            contactid_sm = CID_ST_TRANSMIT;
            audio_tx_play(ev);
          }
          else
          {
            /* Chiudo la comunicazione e riprovo. Se ci sono
               più numeri configurati, chiama il numero successivo. */
            contactid_close_on_error(msg);
            return;
          }
        }
        else if(CID_decode(1400, psamp))
        {
          CID_tentativi = 0;
          contactid_sm_count = 0;
          contactid_retry = 0;
          contactid_sm = CID_ST_ACK;
        }
        break;
      case CID_ST_ACK:
        contactid_sm_count++;
        if(!CID_decode(1400, psamp))
        {
          if(contactid_sm_count >= 40)	// min 400ms
          {
            if(CID_get_message(ev))
            {
              /* Altro evento in coda */
              contactid_sm = CID_ST_HS_MUTE_2;
            }
            else
            {
              /* Fine invio */
              snd_pcm_close(audio_handle_tx);
              audio_handle_tx = NULL;
              snd_pcm_close(audio_handle_rx);
              audio_handle_rx = NULL;
              *msg = 0;
              timeout_on(CID_delay, NULL, NULL, 0, CID_DELAY);
              return;
            }
          }
          else
          {
            /* La segnalazione è stata troppo breve, provo ad
               aspettarne una più lunga (e corretta). */
            contactid_sm = CID_ST_WAIT_ACK;
          }
          contactid_sm_count = 0;
        }
        break;
      default:
        break;
    }
  }
}


